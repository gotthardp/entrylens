## esp32/main/Kconfig.projbuild
```kconfig
menu "Entrylens"

    config WIFI_SSID
        string "WiFi SSID"
        default ""

    config WIFI_PASSWORD
        string "WiFi Password"
        default ""

    config MQTT_BROKER_URL
        string "MQTT broker URL"
        default "mqtts://192.168.1.1"

    config MQTT_TOPIC
        string "MQTT topic for entry/exit events"
        default "entrylens/persons"

    config MQTT_FRAME_TOPIC
        string "MQTT topic for raw 8x8 frame data"
        default "entrylens/frame"

endmenu
```
